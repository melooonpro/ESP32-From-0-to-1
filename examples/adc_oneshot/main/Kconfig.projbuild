## examples/adc_oneshot/main/Kconfig.projbuild
```kconfig
menu "ADC oneshot demo"

config ADC_CHANNEL
    int "ADC1 channel number"
    default 0
    range 0 9
    help
        Select ADC1 channel. Check your board pinout before wiring.

endmenu
```

## examples/freertos_queue/main/Kconfig.projbuild
```kconfig
menu "FreeRTOS queue demo"

config LED_GPIO
    int "LED GPIO number"
    default 2

config BUTTON_GPIO
    int "Button GPIO number"
    default 0

endmenu
```

## examples/gpio_button_led/main/Kconfig.projbuild
```kconfig
menu "GPIO button LED demo"

config LED_GPIO
    int "LED GPIO number"
    default 2
    help
        Set this to the GPIO connected to your LED.

config BUTTON_GPIO
    int "Button GPIO number"
    default 0
    help
        Set this to the GPIO connected to your button.

endmenu
```

## examples/i2c_scanner/main/Kconfig.projbuild
```kconfig
menu "I2C scanner demo"

config I2C_SDA_GPIO
    int "I2C SDA GPIO number"
    default 8

config I2C_SCL_GPIO
    int "I2C SCL GPIO number"
    default 9

endmenu
```

## examples/ledc_fade/main/Kconfig.projbuild
```kconfig
menu "LEDC fade demo"

config LEDC_GPIO
    int "PWM LED GPIO number"
    default 2

endmenu
```

## examples/touch_read/main/Kconfig.projbuild
```kconfig
menu "Touch read example"

    config TOUCH_CHANNEL_ID
        int "Touch channel ID"
        default 1
        help
            Touch channel ID used by this example. For ESP32-S3, check the
            ESP-IDF touch sensor documentation and your board schematic before
            connecting an external touch pad.

endmenu
```

## examples/uart_echo/main/Kconfig.projbuild
```kconfig
menu "UART echo demo"

config UART_TX_GPIO
    int "UART TX GPIO number"
    default 17

config UART_RX_GPIO
    int "UART RX GPIO number"
    default 18

config UART_BAUD_RATE
    int "UART baud rate"
    default 115200

endmenu
```

## examples/wifi_station_http/main/Kconfig.projbuild
```kconfig
menu "Wi-Fi station HTTP demo"

config WIFI_SSID
    string "Wi-Fi SSID"
    default ""

config WIFI_PASSWORD
    string "Wi-Fi password"
    default ""

config HTTP_URL
    string "HTTP URL"
    default "http://example.com/"

endmenu
```
